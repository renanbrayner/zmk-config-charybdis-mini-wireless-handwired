## config/west.yml
```yaml
manifest:
  remotes:
    - name: zmkfirmware
      url-base: https://github.com/zmkfirmware
    - name: petejohanson
      url-base: https://github.com/petejohanson
  projects:
    - name: zmk
      remote: zmkfirmware
      revision: main        # Usa o ZMK oficial estável
      import: app/west.yml
    - name: zmk-pointers    # Driver moderno que não conflita
      remote: petejohanson
      revision: main
  self:
    path: config
```
